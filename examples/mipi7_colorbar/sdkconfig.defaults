## main/Kconfig.projbuild
```kconfig
menu "Deye P4 dashboard"

    config DEYE_WIFI_SSID
        string "WiFi SSID example (compile-time only; SoftAP/NVS preferred)"
        default ""
        help
            Not used for STA unless also saved in NVS (deye_cfg).
            Production devices get SSID via SoftAP portal at http://192.168.4.1.

    config DEYE_WIFI_PASSWORD
        string "WiFi password example (compile-time only)"
        default ""
        help
            Portal/NVS provisioning overrides this. Leave empty for production builds.

    config DEYE_MQTT_HOST
        string "MQTT broker hostname"
        default "192.168.3.249"
        help
            Hostname only (no mqtt:// prefix). Prefill for SoftAP form; override via NVS.

    config DEYE_MQTT_PORT
        int "MQTT broker port"
        default 1883
        range 1 65535

    config DEYE_MQTT_USERNAME
        string "MQTT username"
        default ""

    config DEYE_MQTT_PASSWORD
        string "MQTT password"
        default ""

    config DEYE_MQTT_BASE_TOPIC
        string "MQTT base topic"
        default "iriv/ivt"
        help
            Must match IRIV IOC baseTopic. Same contract as LCD-35.

    config DEYE_STALE_TIMEOUT_S
        int "Telemetry stale timeout (seconds)"
        default 30
        range 5 120

    config DEYE_BACKLIGHT_PCT
        int "LCD backlight percent"
        default 80
        range 5 100

    config DEYE_TZ
        string "POSIX timezone"
        default "ICT-7"
        help
            Used for the status-bar clock after SNTP sync.

    config DEYE_PANEL_H_RES
        int "Panel horizontal resolution"
        default 720
        help
            RPi Touch Display 2 is 720×1280 portrait.

    config DEYE_PANEL_V_RES
        int "Panel vertical resolution"
        default 1280

    config DEYE_DSI_LANES
        int "MIPI DSI lane count (Nano FPC = 2)"
        default 2
        range 1 4
        help
            Waveshare ESP32-P4-Nano LCD FPC is 2-lane.

    config DEYE_NET_ETHERNET
        bool "Prefer Ethernet for MQTT (skip Wi-Fi STA)"
        default n
        help
            When y, app_main brings up Ethernet instead of wifi_sta_start().

endmenu
```
